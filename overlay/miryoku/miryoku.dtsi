// Copyright 2022 Manna Harbour
// https://github.com/manna-harbour/miryoku
//
// Based on upstream master with 3-arg MIRYOKU_X for encoder support.
// The EXTRA parameter allows injecting sensor-bindings per layer.

#include <behaviors.dtsi>
#include <behaviors/mouse_keys.dtsi>
#include <dt-bindings/zmk/keys.h>
#include <dt-bindings/zmk/bt.h>
#include <dt-bindings/zmk/rgb.h>
#include <dt-bindings/zmk/outputs.h>
#include <dt-bindings/zmk/ext_power.h>

#include "miryoku.h"

#include <dt-bindings/zmk/pointing.h>

// keymap-drawer sets KEYMAP_DRAWER in its cpp preamble. Its parser splits on
// whitespace inside binding args, so ZMK's pointing.h MOVE_X/Y (which expand
// to multi-token expressions like "(((val) & 0xFFFF) << 16)") confuse it —
// a &msc SCRL_LEFT becomes three "bindings" and key counts break. Override
// to identity for drawer-only runs; real firmware builds ignore this block.
#ifdef KEYMAP_DRAWER
  #undef MOVE_X
  #undef MOVE_Y
  #define MOVE_X(x) x
  #define MOVE_Y(x) x
#endif

/ {
  keymap {
    compatible = "zmk,keymap";
#define MIRYOKU_X(LAYER, STRING, EXTRA) \
    U_##LAYER## { \
      display-name = STRING; \
      bindings = < U_MACRO_VA_ARGS(MIRYOKU_LAYERMAPPING_##LAYER, MIRYOKU_LAYER_##LAYER) >; \
      EXTRA \
    };
MIRYOKU_LAYER_LIST
#undef MIRYOKU_X
  };
};

#include "miryoku_shift_functions.dtsi"
#include "miryoku_double_tap_guard.dtsi"
#include "miryoku_mousekeys.dtsi"

#if defined (MIRYOKU_KLUDGE_THUMBCOMBOS)
  #include "miryoku_kludge_thumbcombos.dtsi"
#endif

#if defined (MIRYOKU_KLUDGE_TOPROWCOMBOS)
  #include "miryoku_kludge_toprowcombos.dtsi"
#endif

#if defined (MIRYOKU_KLUDGE_BOTTOMROWCOMBOS)
  #include "miryoku_kludge_bottomrowcombos.dtsi"
#endif

#if defined (MIRYOKU_KLUDGE_TAPDELAY)
  #include "miryoku_kludge_tapdelay.dtsi"
#else
  #include "miryoku_behaviors.dtsi"
#endif
